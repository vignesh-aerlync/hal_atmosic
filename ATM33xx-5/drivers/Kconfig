## ATM33xx-5/drivers/Kconfig
```kconfig
# Copyright (c) 2023-2024 Atmosic
#
# SPDX-License-Identifier: Apache-2.0

if SOC_ATM33xx_5

rsource "*/Kconfig"

config MBEDTLS_USER_CONFIG_FILE
	default "atm33-mbedtls-config.h" if ATM_AES_HW || ATM_SHA2_HW || ATM_UECC

endif # SOC_ATM33xx_5
```

## ATM33xx-5/drivers/atm_sha2/Kconfig
```kconfig
# Copyright (c) 2024 Atmosic
#
# SPDX-License-Identifier: Apache-2.0

config ATM_SHA2
	bool "Atmosic SHA2 module"
	default y if ATM_SHA2_HW || ATM_SHA2_HW_BOOTUTIL

config ATM_SHA2_HW
	bool "Hardware accelerator for SHA256 hash"
	default n
	depends on MBEDTLS_HASH_SHA256_ENABLED && !USERSPACE
	select MBEDTLS_USER_CONFIG_ENABLE

config ATM_SHA2_HW_BOOTUTIL
	bool "Hardware accelerator for SHA256 hash supporting bootutil API (only used by MCUBOOT)"
	default n
```

## ATM33xx-5/drivers/ble/Kconfig
```kconfig
# Copyright (c) 2023-2024 Atmosic
#
# SPDX-License-Identifier: Apache-2.0

config EXT_WAKEUP_ENABLE
	int "EXT WAKEUP ENABLE"
	default 1

config ATM_BLE_DRIVER_SLEEP
	bool "Atmosic BLE driver sleep"
	default y

config ATM_SLEEP_ENABLE
	int "Sleep enable value"
	default 2 if ATM_BLE_DRIVER_SLEEP
	default 0

config ATM_SLEEP_ADJ
	int "Sleep adjustment value"
	default 10

config USE_ATMWSTK
	bool "Use fixed BLE stack image"
	default n

config ATMWSTK
	string "Fixed BLE stack image flavor"
	default "LL"
	depends on USE_ATMWSTK

config ATMWSTKLIB
	string "BLE link layer library flavor"
	default "PD50"
	depends on !USE_ATMWSTK
```

## ATM33xx-5/drivers/brwnout/Kconfig
```kconfig
# Copyright (c) 2024 Atmosic
#
# SPDX-License-Identifier: Apache-2.0

config NO_BROWNOUT
	bool "Disable brownout support"
	default y

config BROWNOUT_THR_VBAT
        int "VBAT brownout threshold"
        default 0
        help
            Controls the VBAT brownout threshold for the non-lithium ion battery type.
            For battery level <= 1.8V,
                VBAT threshold = 0.9 + 0.025X, where 0 <= X <= 31
            For battery level > 1.8V,
                VBAT threshold = 1.4 + 0.05X, where
                    0 <= X <= 31, for non-rechargeable battery type
                    0 <= X <= 17, for rechargeable battery type
            The battery level is specified through OTP and is equal to BATT_LEVEL_GT_1P8V by default. It can be overwritten through CONFIG_BATT_LEVEL. Refer to the PMU configuration for additional details.

config BROWNOUT_STACK_SIZE
        int "Brownout thread stack size"
        default 1024

config BROWNOUT_THREAD_PRIORITY
        int "Brownout thread priority"
        default 10
        help
            The thread priority should be lower (higher number) than the application thread priority.
```

## ATM33xx-5/drivers/pmu/Kconfig
```kconfig
# Copyright (c) 2024 Atmosic
#
# SPDX-License-Identifier: Apache-2.0

# Battery configuration
config BATT_TYPE
	int "Battery type"
	default 3
	help
	    The battery type is specified through OTP and is equal to BATT_TYPE_NON_RECHARGEABLE by default. It can be overwritten through this compile time flag based on the board design. Valid battery types:
	    0 => BATT_TYPE_LI_ION
	    1 => BATT_TYPE_RECHARGEABLE
	    2 => BATT_TYPE_NO_BATTERY
	    3 => BATT_TYPE_NON_RECHARGEABLE
	    If you wish to use BATT_TYPE_LI_ION, you will need to first power the board using a power source that is NOT lithium ion then load a program with CONFIG_BATT_TYPE=0. This will enable the lithium ion power ciruit, at which point you can disconnect the non lithium ion power source, hook up the lithium ion battery and proceed like normal.

config VDDIO_TYPE
	int "VDDIO type"
	default 0
	help
	    The 'vddio' type is equal to VDDIO_TYPE_INTERNAL by default and can be overwritten through this compile time flag based on the board design. Valid vddio types:
	    0 => VDDIO_TYPE_INTERNAL
	    1 => VDDIO_TYPE_EXTERNAL
	    Note that the external VDDIO type is determined by the source on the board, which is commonly assumed to be VBAT. Therefore, it is supported for battery level greater than 1.8V.

config BATT_LEVEL
	int "Battery level"
	default 1
	help
	    The battery level is specified through OTP and is equal to BATT_LEVEL_GT_1P8V by default. It can be overwritten through this compile time flag. Valid battery levels:
	    0 => BATT_LEVEL_LE_1P8V (<= 1.8V)
	    1 => BATT_LEVEL_GT_1P8V (> 1.8V)


# Energy harvesting configuration
config VSTORE_MAX
	int "Vstore maximum"
	default 3300
	help
	    The vstore max is specified through OTP. It can be overwritten through this compile time flag. Suppported Vstore max values:
	    - Between 1500 mV - 3000 mV with 50 mV step,
	    - 3100 mV
	    - 3300 mV (default)

config NONRF_HARV
	bool "Enable PV harvesting"
	default n
	help
	    Enables PhotoVoltaic (PV) harvesting. Can be specified with RF_HARV to enable combined harvesting.

config VHARV_RANGE
	int "VHARV range"
	default 16
	depends on NONRF_HARV || HARV_METER
	help
	    Harvesting range needs to be specified for PV harvesting. It can be done at compile time using this flag. Valid vharv range values:
	    0 => VHARV_RANGE_0P4V_0P45V
	    1 => VHARV_RANGE_0P45V_0P5V
	    2 => VHARV_RANGE_0P525V_0P6V
	    3 => VHARV_RANGE_0P6V_0P7V
	    4 => VHARV_RANGE_0P675V_0P8V
	    5 => VHARV_RANGE_0P75V_0P9V
	    6 => VHARV_RANGE_0P825V_1P0V
	    7 => VHARV_RANGE_0P9V_1P1V
	    8 => VHARV_RANGE_0P975V_1P2V
	    9 => VHARV_RANGE_1P05V_1P3V
	    10 => VHARV_RANGE_1P175V_1P45V
	    11 => VHARV_RANGE_1P3V_1P6V
	    12 => VHARV_RANGE_1P5V_1P8V
	    13 => VHARV_RANGE_1P7V_2P0V
	    14 => VHARV_RANGE_1P95V_2P25V
	    15 => VHARV_RANGE_2P2V_2P5V

config RF_HARV
	bool "Enable RF harvesting"
	default n
	help
	    Enables RF harvesting. Can be specified with NONRF_HARV to enable combined harvesting.

config BOOST_FROM_VHARV_INDUCTOR
	bool "Enable charging from VHARV to VBATLI through external inductive boosting circuit"
	default n
	depends on BATT_TYPE = 0 && NONRF_HARV
	help
	    This option is only available with BATT_TYPE=BATT_TYPE_LI_ION, and PV harvesting (CFG_NONRF_HARV and corresponding VHARV_RANGE option). Please refer to the application notes for the applicable scenarios, hardware connections and performance. Based on the characteristic of the selected PV cell, the user needs to choose the upper level or lower level of the VHARV_RANGE by enabling one of the 2 flags: VHARV_LL or VHARV_UL

config VHARV_LL
	bool "VHARV LL"
	default n
	depends on BOOST_FROM_VHARV_INDUCTOR
	help
	    VHARV range lower level

config VHARV_UL
	bool "VHARV UL"
	default n
	depends on BOOST_FROM_VHARV_INDUCTOR
	help
	    VHARV range upper level

config BOOST_FROM_VHARV_TWO_DIODE
	bool "Enable charging from VHARV to VBATLI through external 2-diode boosting circuit"
	default n
	depends on BATT_TYPE = 0 && NONRF_HARV
	help
	    This option is only available with BATT_TYPE=BATT_TYPE_LI_ION, and PV harvesting (CFG_NONRF_HARV and corresponding VHARV_RANGE option). Please refer to the application notes for the applicable scenarios, hardware connections and performance.

config HARV_METER
	bool "Enable harvesting meter"
	default n
	help
	    Supported only when MPPT is disabled. The application needs to call the pmu_set_harv_meter() API to start/stop the meter. The instantaneous power computation depends on the vharv range and the inductor used.

config INDUCTOR_NHENRY
	int "Inductor value in nano henries"
	default 3300
	depends on HARV_METER
	help
	    Inductor being used in the board design for harvesting meter
```

## ATM33xx-5/lib/Kconfig
```kconfig
# Copyright (c) 2024 Atmosic
#
# SPDX-License-Identifier: Apache-2.0

if SOC_ATM33xx_5

config AT_CMD
	bool "AT command support"
	default n

config ATM_VENDOR
	bool "ATM Vendor command library"
        depends on BT_HCI_RAW && BT_HCI_RAW_H4 && BT_HCI_RAW_H4_ENABLE && BT_HCI_RAW_CMD_EXT
	default n

if ATM_VENDOR

rsource "atm_vendor/Kconfig"

endif

endif # SOC_ATM33xx_5
```

## ATM33xx-5/lib/atm_vendor/Kconfig
```kconfig
# Copyright (c) 2024 Atmosic
#
# SPDX-License-Identifier: Apache-2.0

config VND_DBG_MMR
	bool "[0xFC01] DBG Read Memory."
	default y

config VND_DBG_MMW
	bool "[0xFC02] DBG Write Memory."
	default y

config VND_BLE_REGR
	bool "[0xFC30] BLE Register Read."
	default y

config VND_BLE_REGW
	bool "[0xFC31] BLE Register Write."
	default y

config VND_EN_TXCW
	bool "[0xF802] Tx CW mode control - Enable TX CW mode on specific BLE RF Channel(0~39), RF Channel 255 is used to disable Tx CW mode."
	default y

config VND_CAP
	bool "[0xF803] 16MXtal cap. control - set cap. value."
	default y

config VND_SYS_MMR
	bool "[0xF804] Memory read - read system memory value by address."
	default y

config VND_PV_TEST
	bool "[0xF80C] PV Test"
	default y

config VND_VND_PSM
	bool "[0xF80F] PSM - set power save mode."
	default n

config VND_GADC
	bool "[0xF80B] GADC - set gadc value."
	default n

config VND_IO_CTRL
	bool "[0xF80A] IO Control - set io pin."
	default n

config VND_TAG_RD
	bool "[0xF805] Read Flash NVDS Tag - read tag value."
	default n

config VND_SET_BDDR
	bool "[0xF806] Set Public BD Address."
	default n

config VND_MALLOC
	bool "[0xF809] Memory Allocate - Allocate n bytes memory (little endian)."
	default n

config VND_PMU_RADIO_REGR
	bool "[0xFC33] PMU Radio Register Read."
	default n

config VND_COREMARK
	bool "[0xF810] coremark - get coremark score multiplied by 100."
	default n

config VND_WFI
	bool "[0xF811] wfi - do wfi to be used for power measure tests."
	default n

config VND_NO_CLOCK
	bool "[0xF812] no_clock - turn off mpc clock to be used for power measure tests."
	default n

config VND_WHILE_ONE
	bool "[0xF813] while_one - do while_one to be used for power measure tests"
	default n

config ATM_LOG_DEFAULT_LEVEL
	int "atm vendor logging level"
	depends on LOG
	default LOG_DEFAULT_LEVEL

config RUNTIME_EN_HCI_VENDOR
	bool "Runtime Enable HCI vendor"
	default n

config ATM_VENDOR_TX_STACK_SIZE
	int "ATM hci uart tx thread stack size"
	default 400

config ATM_VENDOR_RX_STACK_SIZE
	int "ATM hci uart rx thread stack size"
	default 800
```

## Kconfig
```kconfig
# Copyright (c) 2023-2024 Atmosic
#
# SPDX-License-Identifier: Apache-2.0

rsource "*/drivers/Kconfig"
rsource "*/lib/Kconfig"

rsource "tools/Kconfig"

config ATM_ENABLE_NSC_EXAMPLE
	bool "Enable NSC example function for extending SPE"
	default n

config ATM_PLF_DEBUG
	bool "Debugging for low level platform drivers"
	default y
	depends on PRINTK
```

## tools/Kconfig
```kconfig
# Copyright (c) 2024 Atmosic
#
# SPDX-License-Identifier: Apache-2.0

config GEN_PARTITION_INFO
	bool "Generate partition info"
	default y

config GEN_PARTITION_INFO_SCRIPT
	string "Generate partition info script path"
	default "${ZEPHYR_BASE}/../modules/hal/atmosic/tools/scripts/gen_atm_partition_info.py"
```
